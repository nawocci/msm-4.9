## drivers/soc/oplus/Kconfig
```kconfig
source "drivers/soc/oplus/lowmem_dbg/Kconfig"
source "drivers/soc/oplus/owakelock/Kconfig"
source "drivers/soc/oplus/oplus_healthinfo/Kconfig"
source "drivers/soc/oplus/system/Kconfig"
source "drivers/soc/oplus/thermal/Kconfig"
```
